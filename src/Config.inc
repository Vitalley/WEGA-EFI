; Порты контроллера
; Порты
#define	INJ1	PORTB,1	; Управление форсункой PEACK
#define	INJ2	PORTB,4	; Управление форсункой HOLD
#define	INJ3	PORTB,6
#define	INJ4	PORTB,7
#define	INJ5	PORTC,1
#define	INJ6	PORTC,3
#define	IGN	PORTC,0
#define	PUMP	PORTC,4	; Управление бензонасосом
#define	EPHH	PORTC,2	; Эмуляция концевика ХХ
#define	STEPA	PORTB,2	; Выход линии А на драйвер ШД
#define	STEPB	PORTB,3	; Выход линии Б на драйвер ШД
;#define	ACCEL	PORTC,1	; Сигнализация мощностного режима
#define	ACCEL	PORTB,5
#define	WARM_UP	PORTC,3	; Сигнал режима прогрева
#define	PIN1	PORTA,4	; Тумблер РХХ
; Настройка РХХ
#define	IAC_COLT	D'100'	; количество шагов на открытие после инициализации для -40 С(80)
#define	IAC_WARM	D'25'	; количество шагов на открытие после инициализации для >80 С(20)
#define	IAC_MAX	D'120'	; количество шагов для максимального закрытия клапана (100)
#define	WARM_TRSH	D'40'	; температура включчения прогревочных оборотов
#define	IAC_MIN	D'8'	; Минимальное положение РХХ
#define	IAC_TRSH	D'20'	; Порог быстрого хода РХХ шагов
#define	IAC_SKIP	.600	; положение дросселя для начала регулирования ХХ (mV)
#define	FL_CLEAR	.3027	; положение дросселя для включения режима продувки (mV)
#define	SPD_HOT	.850	; Обороты холостого хода (850)
#define	SPD_WARM	.1250	; Обороты холостого хода при прогреве (1250)
#define	SPD_EPHH	.1600	; Обороты включения экономайзера принудительного холостого хода
#define	MANSETIAC		; Включить возможность ручной установки положения РХХ
#define	MANSETRqF		; Включить возможность ручной регулировки смеси
#define	DEMFER	.26	; Демфер сброса педали акселератора
; Настройка подачи топливной смеси
#define	ReqFuel	.4500	; Количество топлива при 100кПа(мкс)
;#define	LineIntFuelEqual	; Линейная интерполяция для расчёта циклового наполнения
#define	OFFSET	.38	; Offset MAP sensor (.24 = 0.464 В для линеаризации характеристики ДАД)
#define	SLOPE	.242	; Наклон характеристики ДАД, вычисляется давление Pres=(MAP+Offcet)*Slope/256
#define	ACL_THR	05H	; Accelerate theshold
#define	ENR_COEFF	D'1244'	; ЭМР *1000
#define	ENR_TPS	D'1339'	; ОБОГАЩЕНИЕ ПРИ ПОЛНОСТЬЮ ОТКРЫТОМ ДРОССЕЛЕ *1000
#define	CYL	.4	; Количество цилиндров у двигателя по соответствии 4т

;Лаг форсунки в зависимости от напряжения(макс 2047мкс)
#define	LAG086	.1900 ;.1900	
#define	LAG102	.1510;.1600 ;.1510
#define	LAG118	.1100;.1200 ;.1100
#define	LAG134	.880;.880  ;.770
#define	LAG150	.700;.710  ;.610
;Обогащение топлива при прогреве
#define	WARM_ENR_40	0FFH	;-40
#define	WARM_ENR_12	090H	;-12
#define	WARM_ENR_20	04BH	;+20
#define	WARM_ENR_50	018H	;+50
#define	WARM_ENR_80	00H	;+80
; Пусковые параметры
#define	PR_PULSE	.5000	; Время подготовительного импульса впрыска (2мс)
#define	CRANK_HOT	.3000	; время впрыска при запуске на горячую (>80)
#define	CRANK_COLT	.30000	; время впрыска при запуске на холодную (-40)

#define	VE_CORR		; коррекция объёмной характеристики
#define	WARM_CORR		; коррекция смеси при прогреве
#define	ACCEL_CORR		; обогащение при ускорении
#define	ECON_CORR		; Экономайзер мощностных режимов

#DEFINE	ADC_MAP	b'10000001'	; AN0 Датчик абсолютного давления (MPX4100)
#DEFINE	ADC_TPS	b'10001001'	; AN1 Датчик положения дроссельной заслонки
#DEFINE	ADC_COLT	b'10010001'	; AN2 Датчик температуры ОЖ (LM134)
#DEFINE	ADC_PWR	b'10011001'	; AN3 Измеритель напряжения бортсети (делитель 4к/1к)
#DEFINE	ADC_CORR	b'10100001'	; AN4 Потенциометр качества смеси/датчик кислорода

#define	SPD_CONST	.2400000/CYL; Констатна для вычисления оборотов двигателя
;#define	SPD_CONST	.600000	; Констатна для вычисления оборотов двигателя
#define	hctn	.6000	; Коррекция минутного счётчика